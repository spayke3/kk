## drivers/input/fingerprint/Kconfig
```kconfig
#
#Fingerprint
#
menu "Fingerprint support"
	depends on INPUT

config MTK_FINGERPRINT_SUPPORT
	bool "Mediatek Fingerprint"
	default n
	help
	  Fingerprint mtk driver enable/disable
	  in the kernel.Say Y here if you want to
	  use mediatek fingerprint driver,fingerprint
	  driver will support fingerprint function

if MTK_FINGERPRINT_SUPPORT

config MTK_FINGERPRINT_SELECT
	string "sensor type"
	default "GF318M"

source "drivers/input/fingerprint/fpc_mtk_tee/Kconfig"
source "drivers/input/fingerprint/goodix_mtk_tee/Kconfig"

endif

endmenu
```

## drivers/input/fingerprint/fpc_mtk_tee/Kconfig
```kconfig
config FINGERPRINT_FPC_MTK_TEE
	tristate "Support FPC Fingerprint sensor"
	help
	  Say Y here to enable FPC Fingerprint
	  sensor driver for MTK.

	  If unsure, say N.
```

## drivers/input/fingerprint/goodix_mtk_tee/Kconfig
```kconfig
config FINGERPRINT_GOODIX_MTK_TEE
	tristate "Support Goodix Fingerprint sensor"
	help
	  Say Y here to enable Goodix Fingerprint
	  sensor driver for MTK.

	  If unsure, say N.
```

## drivers/input/touchscreen/focaltech_mtk_v3_mmi/Kconfig
```kconfig
#
# Focaltech Touchscreen driver configuration
#

config INPUT_TOUCHSCREEN_FTS_MTK_V3_MMI
    bool "Focaltech Touchscreen"
    default n
    select TOUCHSCREEN_MMI_PANELINFO
    help
      Say Y here if you have Focaltech touch panel.
      If unsure, say N.
```

## drivers/input/touchscreen/himax_mtk_mmi/Kconfig
```kconfig
config INPUT_TOUCHSCREEN_HIMAX_MTK_MMI
	bool "Support Motorola MediaTek Himax touch screen"
	depends on TOUCHSCREEN_MTK
	select TOUCHSCREEN_MMI_PANELINFO
	help
	  Say Y here if you wish to enable the Himax touch
	  screen driver.

	  If unsure, say N.
```

## drivers/input/touchscreen/icnl9916_tddi_mmi/Kconfig
```kconfig
config INPUT_TOUCHSCREEN_ICNL9916_TDDI_MMI
	bool "ICNL9916 TDDI MMI Touch Driver"
    select TOUCHSCREEN_MMI_PANELINFO
	help
	  Say Y here to enable the ICNL9916 TDDI MMI
	  Touch driver.

	  If unsure, say N.
```

## drivers/input/touchscreen/ili9882_mmi/Kconfig
```kconfig
config INPUT_TOUCHSCREEN_ILI9882_MMI
	bool "ILI9882 MMI Touch Driver"
	select TOUCHSCREEN_MMI_PANELINFO
	help
	  Say Y here to enable the ILI9882 MMI Touch
	  driver.

	  If unsure, say N.
```

## drivers/input/touchscreen/ilitek_mtk_v3_mmi/Kconfig
```kconfig
config INPUT_TOUCHSCREEN_ILITEK_MTK_V3_MMI
	bool "Support Motorola MediaTek ilitek touch screen"
	depends on TOUCHSCREEN_MTK
	select TOUCHSCREEN_MMI_PANELINFO
	help
	  Say Y here if you wish to enable the ilitek touch
	  screen driver.

	  If unsure, say N.

config INPUT_TOUCHSCREEN_ILITEK_MTK_V3_MMI_CHARGE_DETECT
	bool "Support charge detect for ilitek_mtk_v3_mmi driver"
	depends on INPUT_TOUCHSCREEN_ILITEK_MTK_V3_MMI
	help
	  Say Y here if you wish to enable charger detection
	  for ilitek_mtk_v3_mmi driver.

	  If unsure, say N.

config INPUT_TOUCHSCREEN_ILITEK_MTK_V3_MMI_GESTURE
	bool "Support gesture detect for ilitek_mtk_v3_mmi driver"
	depends on INPUT_TOUCHSCREEN_ILITEK_MTK_V3_MMI
	help
	  Say Y here if you wish to enable gesture detection
	  for ilitek_mtk_v3_mmi driver.

	  If unsure, say N.
```

## drivers/input/touchscreen/nova_0flash_mmi/Kconfig
```kconfig
config INPUT_TOUCHSCREEN_NOVA_0FLASH_MMI
	bool "Nova 0Flash MMI Touch Driver"
	select TOUCHSCREEN_MMI_PANELINFO
	help
	  Say Y here to enable the Nova 0Flash MMI
	  Touch driver.

	  If unsure, say N.
```

## drivers/input/touchscreen/nt36xxx_mtk_mmi/Kconfig
```kconfig
config INPUT_TOUCHSCREEN_NT36XXX_MTK_MMI
	bool "Support Motorola MediaTek Novatek touch screen"
	depends on TOUCHSCREEN_MTK
	select TOUCHSCREEN_MMI_PANELINFO
	help
	  Say Y here if you wish to enable the Novatek touch
	  screen driver.

	  If unsure, say N.

config INPUT_TOUCHSCREEN_NT36XXX_MTK_MMI_CHARGE_DETECT
	bool "Support charge detect for NT36XXX_MTK_MMI driver"
	depends on INPUT_TOUCHSCREEN_NT36XXX_MTK_MMI
	help
	  Say Y here if you wish to enable charger detection
	  for NT36XXX_MTK_MMI driver.

	  If unsure, say N.

config INPUT_TOUCHSCREEN_NT36XXX_MTK_MMI_MULTI_SUPPLIER
	bool "Support multi supplier for NT36XXX_MTK_MMI driver"
	depends on INPUT_TOUCHSCREEN_NT36XXX_MTK_MMI
	help
	  Say Y here if you wish to enable multi supplier
	  for NT36XXX_MTK_MMI driver.

	  If unsure, say N.
```

## drivers/misc/abov_mmi_overlay_7ch/Kconfig
```kconfig
config ABOV_MMI_OVERLAY_7CH
	bool "ABOV_MMI_OVERLAY_7CH"
	depends on MOTO_SENSORS_CLASS
	help
	  Say Y here to build the abov_mmi_overlay_7ch
	  sensor driver.

	  If unsure, say N.
```

## drivers/misc/mmi_info/Kconfig
```kconfig
config MOTO_MMI_INFO
	bool "Motorola mmi_info driver"
	depends on OF
	help
	  Say Y here to expose the boot, RAM, storage and unit
	  information passed by the Motorola bootloader.

	  If unsure, say N.
```

## drivers/misc/utag/Kconfig
```kconfig
config MOTO_UTAGS
	bool "Motorola utags driver"
	depends on OF && PROC_FS
	help
	  Say Y here to expose the Motorola utags and hw partitions
	  under /proc/config and /proc/hw.

	  If unsure, say N.
```

## drivers/sensors/Kconfig
```kconfig
menu "Motorola Sensor Class"

config MOTO_SENSORS_CLASS
	bool "Motorola sensors device class"
	help
	  Say Y here to enable support for Motorola sensors
	  device class.

	  If unsure, say N.

endmenu
```
